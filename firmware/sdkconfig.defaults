## firmware/sdkconfig.defaults
```kconfig
# Configurações para ESP32S3 (XIAO ESP32S3 Sense)
CONFIG_IDF_TARGET="esp32s3"
CONFIG_IDF_TARGET_ESP32S3=y

# Configurações específicas para WiFi/lwIP
CONFIG_TCP_OVERSIZE_MSS=1
CONFIG_LWIP_DHCP_COARSE_TIMER_SECS=60

# Outras configurações necessárias
CONFIG_ESP32S3_DEFAULT_CPU_FREQ_MHZ=240
CONFIG_ESP32S3_SPIRAM_SUPPORT=1

# Configurações de particionamento
CONFIG_PARTITION_TABLE_CUSTOM=y
CONFIG_PARTITION_TABLE_CUSTOM_FILENAME="partitions.csv"

# Configurações para o sistema de arquivos
CONFIG_PARTITION_TABLE_OFFSET=0x8000
CONFIG_SPIFFS_MAX_PARTITIONS=3

# Configurações de memória
CONFIG_SPIRAM_BANKSWITCH_ENABLE=y
```
